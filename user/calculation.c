#include "stm32f10x.h"
#include "include.h"

extern u8  USART1_TxLen;
extern u8  USART1_TxBuffer[255];

//高位字节表 /* Table of CRC values for high–order byte */
static unsigned char auchCRCHi[] = {
0x00, 0xC1, 0x81, 0x40, 0x01, 0xC0, 0x80, 0x41, 0x01, 0xC0, 0x80, 0x41, 0x00, 0xC1, 0x81,
0x40, 0x01, 0xC0, 0x80, 0x41, 0x00, 0xC1, 0x81, 0x40, 0x00, 0xC1, 0x81, 0x40, 0x01, 0xC0,
0x80, 0x41, 0x01, 0xC0, 0x80, 0x41, 0x00, 0xC1, 0x81, 0x40, 0x00, 0xC1, 0x81, 0x40, 0x01,
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0x00, 0xC1, 0x81, 0x40, 0x01, 0xC0, 0x80, 0x41, 0x01, 0xC0, 0x80, 0x41, 0x00, 0xC1, 0x81,
0x40
};
//低位字节表 /* Table of CRC values for low–order byte */
static char  auchCRCLo[] = {
0x00, 0xC0, 0xC1, 0x01, 0xC3, 0x03, 0x02, 0xC2, 0xC6, 0x06, 0x07, 0xC7, 0x05, 0xC5, 0xC4,
0x04, 0xCC, 0x0C, 0x0D, 0xCD, 0x0F, 0xCF, 0xCE, 0x0E, 0x0A, 0xCA, 0xCB, 0x0B, 0xC9, 0x09,
0x08, 0xC8, 0xD8, 0x18, 0x19, 0xD9, 0x1B, 0xDB, 0xDA, 0x1A, 0x1E, 0xDE, 0xDF, 0x1F, 0xDD,
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0x44, 0x84, 0x85, 0x45, 0x87, 0x47, 0x46, 0x86, 0x82, 0x42, 0x43, 0x83, 0x41, 0x81, 0x80,
0x40
};

/*
*	函数名：U32_To_Char(u32 a)
*	描述：	将一个无符号长整型数据(unsigned long int)转换为字符串显示
*	输入：	u32 a,一个长整型数据
*	输出： 	无
*	返回：	无
*/
void U32_To_Char(u32 a)
{
	u8 c[10],i;
	c[0]=a/1000000000+48;
	c[1]=(a%1000000000)/100000000+48;
	a=(a%1000000000)%100000000;
	c[2]=a/10000000+48;
	c[3]=(a%10000000)/1000000+48;
	a=(a%10000000)%1000000;
	c[4]=a/100000+48;
	c[5]=(a%100000)/10000+48;
	a=(a%100000)%10000;
	c[6]=a/1000+48;
	c[7]=(a%1000)/100+48;
	a=(a%1000)%100;
	c[8]=a/10+48;
	c[9]=a%10+48;
	for(i=0;i<=9;i++)
	USART1_TxBuffer[i]=c[i];
	USART1_TxBuffer[10]=0x0D;
	USART1_TxBuffer[11]=0x0A;
	USART1_TxLen=12;
	//USART1_SendDW();
}

/*
	函数名：Data_CRC(u8 *p1,u8 p2,u8 len)
	描述：	计算一组数组的CRC值，从指针p1处开始计算，长度为len，所有数据相加，
			取反，然后以ASCII码发送出去。
	输入：	*p1被计算数组指针，*p2输出数组指针，len被计算数组长度
	输出：	无
	返回：	无
*/	
//unsigned short  CRC16(unsigned char *puchMsg,unsigned short usDataLen)
void Data_CRC(unsigned char *puchMsg, u8 *p2, unsigned short usDataLen)
{
	u16 sum;
	u8 i;
	unsigned char uchCRCHi = 0xFF;		//初始化高字节
	unsigned char uchCRCLo = 0xFF;		//初始化低字节
	unsigned short uIndex;		//把CRC表
	while(usDataLen--)
	{
		uIndex=uchCRCHi ^ *puchMsg++;	//计算CRC
		uchCRCHi=uchCRCLo ^ auchCRCHi[uIndex];
		uchCRCLo=auchCRCLo[uIndex];
	}
	sum=uchCRCHi<<8 | uchCRCLo;
	i=sum/0x1000;
	if(i>=10) i=i+55;
	else i=i+48;
	*p2=i;
	i=(sum % 0x1000) /0x100;
	if(i>=10) i=i+55;
	else i=i+48;
	*++p2=i;
	sum=sum % 0x1000 %0x100;
	i=sum/0x10;
	if(i>=10) i=i+55;
	else i=i+48;
	*++p2=i;
	i=sum%0x10;
	if(i>=10) i=i+55;
	else i=i+48;
	*++p2=i;
}
//标准CRC算法
unsigned short CRC16(unsigned char *puchMsg,unsigned short usDataLen)
{
	unsigned char uchCRCHi = 0xFF;		//初始化高字节
	unsigned char uchCRCLo = 0xFF;		//初始化低字节
	unsigned short uIndex;		//把CRC表
	while(usDataLen--)
	{
		uIndex=uchCRCHi ^ *puchMsg++;	//计算CRC
		uchCRCHi=uchCRCLo ^ auchCRCHi[uIndex];
		uchCRCLo=auchCRCLo[uIndex];
	}
	return (uchCRCHi<<8 |uchCRCLo);
}

/*
	函数名： Cu8_To_Char(u8 *p, u8 len)
	描述：	 把一个无符号小于100的数据转换为ASCII码，并通过指针*p传出
	输入：	 len<100，传出指针*p,高位在前，低位在后
	输入：	 无
	返回：	 无
*/
void Cu8_To_Char(u8 *p, u8 a)
{
	*p=(a%100)/10+48;
	*++p=(a%100)%10+48;
}

/*
*	函数名：U32_To_Char(u32 a)
*	描述：	将一个无符号长整型数据(unsigned long int)转换为字符串显示
*	输入：	u32 a,一个无符号长整型数据，u8 *p返回的数据指针
*	输出： 	无
*	返回：	无
*/
void Cu32_To_Char(u32 a,u8 *p)
{
	//c[0]=a/1000000000+48;				//十亿
	//c[1]=(a%1000000000)/100000000+48;	//亿
	a=(a%1000000000)%100000000;
	//c[2]=a/10000000+48;					//千万
	//c[3]=(a%10000000)/1000000+48;		//百万
	a=(a%10000000)%1000000;
	*p=a/100000+48;						//十万
	*++p=(a%100000)/10000+48;			//万
	a=(a%100000)%10000;					
	*++p=a/1000+48;						//千
	*++p=(a%1000)/100+48;				//百
	a=(a%1000)%100;	
	*++p=a/10+48;						//十
	*++p=a%10+48;						//个
}

/*
	函数名： void u32_to_decimalist(u32 buf,u8 *p)
	描述：	 将一个u32的数据转换为十进制的字符串
	输入：	 u32数据，接收字符串首地址,接收缓冲器需要是个字节长度
	返回：	 无
*/
void u32_to_decimalist(u32 buf,u8 *p)
{
	*p  =u8_to_char(buf / 1000000000);
	*++p=u8_to_char(buf % 1000000000 / 100000000);
	*++p=u8_to_char(buf % 100000000 /  10000000);
	*++p=u8_to_char(buf % 10000000 /   1000000);
	*++p=u8_to_char(buf % 1000000 /    100000);
	*++p=u8_to_char(buf % 100000 /	   10000);
	*++p=u8_to_char(buf % 10000 /      1000);
	*++p=u8_to_char(buf % 1000 /       100);
	*++p=u8_to_char(buf % 100 /        10);
	*++p=u8_to_char(buf % 10);
}

/*
	函数名： u8 u8_to_char(u8 buf)
	描述：	 将0~15的十进制数转换为0~9~A~F的字符
	输入：	 0~15的十进制数,若输入大于15，则返回0x01;
	返回：	 0~9~A~F的字符，A~F为大写
*/
u8 u8_to_char(u8 buf)
{
	if(buf < 10)
	{
		return buf+0x30;
	}
	else if(buf < 16)
	{
		return buf+0x41-10;
	}
	else 
		return 0x01;
}

/*
*	函数名：Check_Data(u8 *pointer, u8 len)
*	描述：	从起始字开始按字节累加到校验字前，取低位结果，然后取反，
			传输时将取反的结果转换成2字节ASCII数值，并高位在前。例
			如取反后的结果是0x4B，转换成2字节ASCII数值‘4’‘B’，传输
			时‘4’在前。
*	输入：	*pointer数据指针入口，u8 len 数据长度
*	输出：	无
*	返回：	若为0则校验成功
*/
u8 Check_Data(u8 *pointer, u8 len)
{
	u8 i,a,b,c;
	for(i=0;i<len-4;i++) a+=*pointer++;
	a=a+1;
	a=~a;;
	b=a/16;
	if(b>=10) b=b+55;
	else b=b+48;
	c=a%16;
	if(c>=10) c=c+55;
	else c=c+48;
	if((b==*(pointer)) && (c==*(pointer+1))) return 1;
	else 
	return 0;
}

/*
	函数名： u16_char(u8 *pointer, *u8 len)
	描述：   将一个u16的数据转换为char类型显示
	输入：   u16 tmp数据，输出指针p
	输出：	 无
	返回：	 无
*/
void u16_char(u16 tmp, u8 *p)
{
// 	*p=tmp/10000+48;	//万位
// 	*++p=(tmp%10000)/1000+48;	//千位
	*p=((tmp%10000)%1000)/100+48;	//百位
	*++p=(((tmp%10000)%1000)%100)/10+48;	//十位
	*++p=tmp%10+48;		//个位
}

/*
	超高频读卡器CRC校验
*/
#define PRESET_VALUE 0xFFFF
#define POLYNOMIAL 0x8408
unsigned int uiCrc16Cal(unsigned char const *pucY, unsigned char ucX)
{ 
	unsigned char ucI,ucJ; 
	unsigned short int uiCrcValue = PRESET_VALUE; 
	for(ucI = 0; ucI < ucX; ucI++) 
	{ 
		uiCrcValue = uiCrcValue ^ *(pucY + ucI); 
		for(ucJ = 0; ucJ < 8; ucJ++) 
		{ 
			if(uiCrcValue & 0x0001) 
			{ 
				uiCrcValue = (uiCrcValue >> 1) ^ POLYNOMIAL; 
			} 
			else 
			{ 
				uiCrcValue = (uiCrcValue >> 1); 
			} 
		} 
	} 
	return uiCrcValue; 
}

/*
	函数名： Char_Compare(u8 *p1,u8 *p2, u8 len)
	描述：	 比较两个相等的数据是否相同，若相同则返回1，否则返回0
	输入：	 u8 *p1数组1首地址，u8 *p2数组2首地址，u8 len数组长度
	输出：	 无
	返回：	 u8，若两组数据相同则返回TRUE,否则返回FAUSE
	
*/
u8 Char_Compare(u8 *p1,u8 *p2, u8 len)
{
	u8 i;
	for(i=0;i<len;i++)
	{
		if(*p1==*p2) 
		{
			p1++;
			p2++;
		}
		else return 0;
	}
	return 1;
}

/*
	函数名： u8 IsChar(u8 *P)
	描述：	 判断一串数组是否都是可显示字符串
	输入：	 数组指针入口
	输出：	 无
	返回：	 若该数字所有的成员都是字符则返回TRUE,否则返回FAUSE
*/
u8 IsChar(u8 *P,u8 Len)
{
	u8 i;
	for(i=0;i<Len;i++)
	{
		if((*P >=0x20) && (*P <=0x7E))
			P++;	
		else return 0;
	}
	return 1;
}


